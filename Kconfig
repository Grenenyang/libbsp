## Kconfig
```kconfig
mainmenu "WT eth tool Build Configuration"

source "$(PRJ_ROOT)/usource/Kconfig"

source "$(PRJ_ROOT)/ksource/Kconfig"
```

## configs/B216_defconfig
```kconfig
CONFIG_JSON_PATH="/dev/libbsp.cfg"
CONFIG_CLASS_SWITCH=y
CONFIG_DRIVER_RTL9071=y
CONFIG_KSOURCE_SWITCH=y
CONFIG_KSOURCE_SWITCH_RTL7071=y
```

## configs/test_defconfig
```kconfig
CONFIG_JSON_PATH="/data/hengyang/work/libbsp/libbsp-master/libbsp-master/configs/json/libbsp.cfg"
CONFIG_CLASS_SWITCH=y
CONFIG_DRIVER_RTL9071=y
```

## files/Kconfig
```kconfig
mainmenu "WT eth tool Build Configuration"

config JSON_PATH
     string "build json config path"
     default ""
     help
         "libbsp config file"

source "$(PRJ_ROOT)/usource/Kconfig"

source "$(PRJ_ROOT)/ksource/Kconfig"
```

## files/ksource/Kconfig
```kconfig
# ksource/Kconfig - 内核态驱动配置（控制是否编译进 KO）
menu "ksource Configuration"

menuconfig KSOURCE_SWITCH
    bool "class switch"
    default n
    help
        class switch.
source "$(PRJ_ROOT)/ksource/switch/Kconfig"
endmenu
```

## ksource/Kconfig
```kconfig
# ksource/Kconfig - 内核态驱动配置（控制是否编译进 KO）
menu "Kernel-space Drivers Configuration"

config BUILD_KERN_DRIVERS
    bool "Build kernel-space drivers into hardware_drv.ko"
    default y
    help
        Enable/disable all kernel-space drivers in single KO.

if BUILD_KERN_DRIVERS

config KERN_SWITCH_RTL9071
    bool "Build RTL9071 switch driver into hardware_drv.ko"
    default y
    help
        Include RTL9071 switch driver in hardware_drv.ko.

config KERN_PHY_JL3XXX
    bool "Build JL3XXX PHY driver into hardware_drv.ko"
    default y
    help
        Include JL3XXX PHY driver in hardware_drv.ko.

# 新增内核驱动只需添加：
# config KERN_NEW_DRIVER
#     bool "Build New Driver into hardware_drv.ko"
#     default n

endif # BUILD_KERN_DRIVERS
endmenu
```

## ksource/switch/Kconfig
```kconfig
config KSOURCE_SWITCH_RTL7071
    bool "kdriver rtl9071"
    depends on KSOURCE_SWITCH
    default n
    help
        kdriver rtl9071
```

## usource/Kconfig
```kconfig
# usource/Kconfig - 用户态驱动配置（包含 core 核心代码）
menu "Usource Configuration"

# 驱动配置开关
menuconfig CLASS_SWITCH
    bool "class switch"
    default n
    help
        class switch.
source "$(PRJ_ROOT)/usource/switch/Kconfig"
config CLASS_PHY
    bool "classs phy"
    default b
    help
        class phy

endmenu
```

## usource/switch/Kconfig
```kconfig
config DRIVER_RTL9071
    bool "build switch 9071"
    depends on CLASS_SWITCH
    help
        class switch.
```
